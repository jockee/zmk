## custom_behavior/Kconfig
```kconfig
config ZMK_BEHAVIOR_CYCLE_STRING
    bool "Enable Cycle String Behavior"
    default n
    help
        This option enables the custom cycle string behavior.
```

## custom_behavior/dts/bindings/behaviors/chord-cycle,behavior-cycle-string.yaml
```yaml
compatible: "chord-cycle,behavior-cycle-string" # Must match DT_DRV_COMPAT in C code

description: |
    Behavior that cycles through predefined strings on repeated presses.
    On each press (after the first), it sends backspaces to delete the
    previously typed string, then types the next string in the sequence.

binding-cells:
  - param1 # Just the name of the cell

properties:
  # Properties for the binding cells are defined here
  param1:
    type: int
    required: true
    description: |
      Index of the string list to cycle through. The lists are defined
      in the behavior's C code (behavior_cycle_string.c). Index 0
      corresponds to the first list defined, index 1 to the second, etc.
```

## dts/bindings/behaviors/chord-cycle,behavior-cycle-string.yaml
```yaml
# SPDX-License-Identifier: MIT
description: Chord Cycle String Behavior
compatible: "chord-cycle,behavior-cycle-string"

include: zmk,behavior.yaml
```
